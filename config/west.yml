## config/west.yml
```yaml
manifest:
  remotes:
    - name: d2g45
      url-base: https://github.com/d2g45
  projects:
    - name: zmk
      remote: d2g45
      revision: sofle
      import: app/west.yml
  self:
    path: config
```
